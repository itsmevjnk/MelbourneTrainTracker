## MTT_Firmware/main/Kconfig.projbuild
```kconfig
menu "Firmware Configuration"
    choice MUNNEL_COLOUR
        prompt "Metro Tunnel service colour handling"
        default MUNNEL_COLOUR_BLUE
        config MUNNEL_COLOUR_BLUE
            bool "Show all services in Metro Tunnel/Dandenong group blue"
        config MUNNEL_COLOUR_DEST
            bool "Show service colour depending on direction (e.g. yellow for Sunbury)"
        config MUNNEL_COLOUR_NONE
            bool "Change service colour within the Metro Tunnel"
    endchoice

    config WIFI_CONFIGAP_SSID_PREFIX
        string "Configuration AP SSID prefix"
        default "melbtrains"
        help
            Sets the SSID prefix for the configuration Wi-Fi access point.
    
    config WIFI_CONFIGAP_SSID_MAC
        bool "Include STA MAC address in configuration AP SSID"
        default y
        help
            When enabled, the ESP32's station mode MAC address will be included in the configuration AP's SSID.
            This allows for the easy identification of the board to be configured.

    config WIFI_CONFIGAP_CHANNEL
        int "Configuration AP channel"
        range 1 13
        default 6
        help
            The Wi-Fi channel to be used for the configuration AP.
    
    config WIFI_CONFIGAP_MAXCONN
        int "Maximum number of clients for configuration AP"
        default 4
        help
            The maximum number of clients that can connect to the configuration AP at any time.

    config DEFAULT_TIME_SERVER
        string "Default NTP time server"
        default "pool.ntp.org"
        help
            Sets the default NTP time server hostname/IP address to use if it is not configured in the NVS.
    
    config DEFAULT_MQTT_BROKER
        string "Default MQTT broker address"
        default "mqtt://melbtrains.mooo.com"
        help
            Sets the default MQTT broker address (including the schema) to use if it is not configured in the NVS.

    config DEFAULT_MDNS_HOSTNAME
        string "Default mDNS hostname"
        default "melbtrains"
        help
            Sets the default mDNS hostname to use if it is not configured in the NVS.
    
    config DEFAULT_MDNS_INSTANCE_NAME
        string "Default mDNS instance name"
        default "Melbourne Train Tracker"
        help
            Sets the default mDNS instance name (user-friendly description) to use if it is not configured in the NVS.

    config MSG_STATION_PAD
        int "Station departure padding duration (sec)"
        range 0 60
        default 15
        help
            Sets the duration to add to the received departure time of a service in seconds.
    
    config PROMPT
        string "Configuration CLI prompt"
        default "config>"
        help
            Sets the prompt string for the configuration CLI.
    
    config MAX_CMDLINE_LENGTH
        int "Maximum configuration CLI command line length"
        range 0 512
        default 128
        help
            Sets the maximum command line length in the configuration CLI.
    
    config SERVICES_CAPACITY_GROWTH
        int "Services buffer growth step"
        range 1 50
        default 10
        help
            Sets the number of additional service objects allocated when Services::m_allStates is grown beyond the reserved size.
    
    config LMAT_STRICT_COLOUR_CHECK
        bool "Enable strict line colour checking"
        default n
        help
            When enabled, the LEDMatrix subsystem will check if the LED's colour matches the expected colour for the line it is on.
            If the colour does not match, abort() will be invoked, allowing for the detection of illegal memory reads.
            
    config SPI3_ONLY
        bool "Use SPI3 (VSPI) only"
        default n
        help
            Enable this if the board is wired to have all LED matrix drivers' SPI buses connected to SPI3/VSPI (GPIO 18/19/21).
            This allows the SPI2/HSPI pins to be used for JTAG debugging.
    
    config UPDATE_FLASH_LED
        bool "Flash activity LED during LED state updates"
        default y
        help
            When enabled, the activity LED will flash during the duration of LED state updates, in addition to MQTT message retrieval.
            This can be turned off if it is too distrcting.
    
    config UPDATE_INTERVAL
        int "LED state update interval (msec)"
        range 0 10000
        default 1000
        help
            The LED state update interval in milliseconds. This should be a multiple of 1000 (i.e. steps of 1 second).

    config HTTP_PORT
        int "HTTP server port"
        range 1 65535
        default 80
        help
            The status/management HTTP server's port.

endmenu
```

## MTT_Firmware/sdkconfig.defaults.esp32s3
```kconfig
# CONFIG_ESP_CONSOLE_UART_DEFAULT is not set
# CONFIG_ESP_CONSOLE_USB_CDC is not set
CONFIG_ESP_CONSOLE_USB_SERIAL_JTAG=y
# CONFIG_ESP_CONSOLE_UART_CUSTOM is not set
# CONFIG_ESP_CONSOLE_NONE is not set
CONFIG_ESP_CONSOLE_SECONDARY_NONE=y
CONFIG_ESP_CONSOLE_USB_SERIAL_JTAG_ENABLED=y
CONFIG_ESP_CONSOLE_UART_NUM=-1
CONFIG_ESP_CONSOLE_ROM_SERIAL_PORT_NUM=4

CONFIG_ESP_SYSTEM_BBPLL_RECALIB=y

CONFIG_ESPTOOLPY_FLASHSIZE_8MB=y
CONFIG_ESPTOOLPY_FLASHSIZE="8MB"

#
# ESP PSRAM
#
CONFIG_SPIRAM=y

#
# SPI RAM config
#
# CONFIG_SPIRAM_MODE_QUAD is not set
CONFIG_SPIRAM_MODE_OCT=y
CONFIG_SPIRAM_TYPE_AUTO=y
# CONFIG_SPIRAM_TYPE_ESPPSRAM64 is not set
CONFIG_SPIRAM_CLK_IO=30
CONFIG_SPIRAM_CS_IO=26
# CONFIG_SPIRAM_XIP_FROM_PSRAM is not set
# CONFIG_SPIRAM_FETCH_INSTRUCTIONS is not set
# CONFIG_SPIRAM_RODATA is not set
CONFIG_SPIRAM_SPEED_80M=y
# CONFIG_SPIRAM_SPEED_40M is not set
CONFIG_SPIRAM_SPEED=80
# CONFIG_SPIRAM_ECC_ENABLE is not set
CONFIG_SPIRAM_BOOT_HW_INIT=y
CONFIG_SPIRAM_BOOT_INIT=y
CONFIG_SPIRAM_PRE_CONFIGURE_MEMORY_PROTECTION=y
# CONFIG_SPIRAM_IGNORE_NOTFOUND is not set
# CONFIG_SPIRAM_USE_MEMMAP is not set
# CONFIG_SPIRAM_USE_CAPS_ALLOC is not set
CONFIG_SPIRAM_USE_MALLOC=y
CONFIG_SPIRAM_MEMTEST=y
CONFIG_SPIRAM_MALLOC_ALWAYSINTERNAL=16384
# CONFIG_SPIRAM_TRY_ALLOCATE_WIFI_LWIP is not set
CONFIG_SPIRAM_MALLOC_RESERVE_INTERNAL=32768
# CONFIG_SPIRAM_ALLOW_BSS_SEG_EXTERNAL_MEMORY is not set
# CONFIG_SPIRAM_ALLOW_NOINIT_SEG_EXTERNAL_MEMORY is not set
# end of SPI RAM config
# end of ESP PSRAM

CONFIG_PARTITION_TABLE_CUSTOM=y
CONFIG_PARTITION_TABLE_CUSTOM_FILENAME="partitions.esp32s3.csv"
CONFIG_PARTITION_TABLE_FILENAME="partitions.esp32s3.csv"
```
